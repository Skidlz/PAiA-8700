;********************************
;*                              *
;*         ECHO 0.31            *
;*                              *
;*   POLYPHONIC VOICE QUEUING   *
;*                              *
;*            BY                *
;*       JOHN SIMONTON          *
;*                              *
;*(C) 1979 PAIA ELECTRONICS, INC*
;*     ALL RIGHTS RESERVED      *
;*                              *
;********************************
;
EPNT	= $00BE
NTBL	= $00D0	;MUS1 OUTPUT BUFFER
CHN1	= $00DF
OUTT	= $00EB
CNTR	= $00EC

EBUF	= $0200
DISP 	= $0820
INIT	= $0D21 ;MUS1
NOTE	= $0D2B ;MUS1
FILL	= $0D52 ;MUS1
POLY	= $0D71	;MUS1
DECD	= $0F00	;PIEBUG
BRAK	= $FFC0	;PIEBUG

	org	$1000
;
;INITIALIZE SYSTEM, CLEAR OUTPUT BUFFERS AND ECHO BUFFER
;
STAR	jsr	INIT		;CALL MUS1 INITIALIZATION
		ldx	#$FF		;PREPARE TO SET STACK POINTER
		txs				;SET STACK TO TOP OF PAGE
EBZR	lda	#$00		;PREPARE TO ZERO OUT ECHO BUFFER
		ldx	#$3F		;POINTER TO END OF ECHO BUFFER
ILP		sta	EBUF,x		;ZERO ECHO BUFFER LOCATION
		dex				;POINT TO NEXT LOCATION
		bpl	ILP			;NOT DONE YET, LOOP
ECHO	jsr	POLY		;CALL MUS1 POLYPHONIC ALLOCATION
;
;DETERMINE ADDRESS OF THE FIRST CHANNEL AVAILABLE
;FOR ECHO USE
;
		ldy	#$0F		;OFFSET TO FIRST OUT-BUF LOCATION
		ldx	<OUTS		;NUMBER OF POLYPHONIC CHANNELS
LP0		dey				;POINT TO NEXT OUTPUT CHANNEL
		dex				;ONE LESS POLY CHANNEL
		bne	LP0			;ALL POLY CHANS NOT USED, LOOP
		sty	<OUTT		;SAVE FIRST ECHO POINTER FOR LATER
;
;ADVANCE ECHO BUFFER POINTER AND ADJUST IF NECESSARY
;
		ldx	<EPNT		;GET CURRENT ECHO BUFFER POINTER
		dec	<CNTR		;DECREMENT TIMER
		bne	GETN		;TIME NOT UP, BRANCH
		lda	<EDLY		;TIME UP, RE-INIT TIMER VALUE
		sta	<CNTR		;RE-INITIALIZE TIMER
		dex				;POINT TO NEXT
		bpl	GETN		;BRANCH IF STILL WITHIN BUFFER AREA
		ldx	#$3F		;OTHERWISE, RE-INIT POINTER
GETN	stx	<EPNT		;SAVE NEW POINTER
;
;PUT CURRENT CHANNEL 1 NOTE IN ECHO BUFFER AND
;PREPARE ECHO CHANNEL COUNTER
;
		lda	<CHN1		;GET CHANNEL 1 NOTE
		sta	EBUF,x		;SAVE IN ECHO BUFFER
		lda	<ECCO		;GET NUMBER OF ECHO CHANNELS
		sta	<TEMP		;SAVE AS COUNTER
;
;CALCULATE SUCCESSIVE ECHO BUFFER LOCATIONS AND
;ADJUST AS NECESSARY
;
LP1		txa				;ECHO BUFFER POINTER TO ACCUMULATOR
		clc				;PREPARE FOR ADDITTION
		adc	<OFST		;CALCULATE NEXT LOCATION
		cmp	#$40		;STILL WITHIN ECHO BUFFER?
		bcc	SAVE		;YES, BRANCH TO CONTINUE
		sec				;NO, SET CARRY FOR SUBTRACTION
		sbc	#$40		;AND ADJUST POINTER
SAVE	tax				;PUT POINTER IN PLACE
;
;THEN PULL NOTES FROM ROTATED ECHO BUFFER LOCATIONS
;AND PLACE IN ECHO CHANNELS OF OUTPUT BUFFER (NTBL)
;
		lda	EBUF,x		;GET NOTE FROM ECHO BUFFER
		sta	NTBL,y		;PLACE TO OUTPUT CHANNEL
		dey				;POINT TO NEXT OUTPUT CHANNEL
		dec	<TEMP		;ONE LESS ECHO CHANNEL
		bne	LP1			;BUT SOME LEFT, LOOP
;
;NOTES ARE PLAYED BY CALLING THE QUASH DRIVER (NOTE).
;FINALLY, ECHO OUTPUT CHANNELS ARE CLEARED SO AS NOT
;TO CONFUSE POLY WHEN CALLED
;
		jsr	NOTE		;CALL MUST QUASH DRIVERS, ETC.
		ldy	<OUTT		;GET FIRST ECHO CHANNEL POINTER
		ldx	<ECCO		;GET # OF ECHO CHANNELS
		lda	#$00		;PREPARE TO ZERO
LP2		sta	NTBL,y		;ZERO EACHO OUTPUT CHANNEL
		dey				;POINT TO NEXT OUTPUT
		dex				;ONE LESS ECHO CHANNEL
		bne	LP2			;SOME LEFT, LOOP
;
;READ COMMANDS. 0-3; PRESETS, 4-INITIALIZE SYSTEM
;5-CLEAR ECHO, 6-BREAK, 7-TUNE
;
		jsr	DECD		;READ COMMAND KEYBOARD
		cmp	#$04		;IS COMMAND A PRE-SET?
		bpl	NEXT		;NO, BRANCH FOR NEXT TEST
;
;THE COMMAND IS TO CALL UP A PRE-SET.  AFTER CALCULATING
;THE BASE ADDRESS OF THE PRE-SETS CALLED FOR, THE PRESETS
;VALUES ARE TRANSFERED TO THEIR RESPECTIVE LOCATIONS
;AS ACTIVE PARAMETERS. NOTE THAT THE NUMBER OF
;CHANNELS ALLOCATED TO POLY USAGE (OUTS - $00EA) IS IN
;NON-CONTIGUOUS LOCATION AND MUST BE HANDLED SEPARATELY
;NOTE THAT THE CONTIGUOUS LOCATION *TEMP IS USED AS ACCUMULATOR
;DUMMY VARIABLE AT THIS POINT
;
		sty	DISP		;SHOW PRESET
		lda	#$FF		;ONE LESS THAN PRESETS BASE ADDRESS
LP3		clc				;PREPARE FOR CALCULATION
		adc	#$04		;THERE ARE 4 PRESET VARIABLES
		dey				;POINT TO NEXT PRESET BASE
		bpl	LP3			;IF NOT THIS PRESET, LOOP
		tax				;PUT POINTER CALCULATED TO X
		ldy	#$03		;4 PRESETS, WILL COUNT TO -1
LP4		lda	<PRST,x		;GET PRE-SET DATA
		sta	lo TEMP,y	;AND PLACE AS ACTIVE PARAMETER
		dex				;POINT TO NEXT PRESET DATA
		dey				;AND NEXT ACTIVE PARAMETER
		bpl	LP4			;IF NOT DONE, LOOP
		sta	<OUTS		;SAVE THE MAVERICK PARAMETER
		bmi	ECHO		;BRANCH ALWAYS
;
NEXT	beq	$1100		;COMMAND IS FOR CLEAR, BRANCH
		cmp	#$06		;IS COMMAND 5 (CLEAR ECHO) OR (BRK)?
		bmi	EBZR		;COMMAND IS CLEAR ECHO, BRANCH
		bne	NXT0		;COMMAND IS NOT BRK, BRANCH
		jsr	INIT		;SHUT DOWN SYNTHESIZER
		jmp	BRAK		;AND RETURN TO MONITOR

NXT0	cmp	#$07		;IS COMMAND TUNE?
		bne	BRDG		;A BRANCH TOO FAR
		ldy	#$5C		;PREPARE TO TUNE TO MIDDLE C
		jsr	FILL		;SEE MUS 1.0 DOCUMENTATION
BRDG	jmp	ECHO		;PLAY ON AND ON AND ON
;
;SET-UP VARIABLES FOR MUS1
	org $10BA			;INITIAL PRE-SET
TEMP	db	$01
ECCO	db	$03			;# OF ECHO CHANNELS
EDLY	db	$02
OFST	db	$04
	org $10E8			;SYSTEM CONTROL AND QUASH DELAY
CTRL	db	$40			;MUS1
ODLY	db	$20			;MUS1
OUTS	db	$01			;AND OUTS
	org $109A
PRST	db	$01, $07, $01, $01
		db	$01, $07, $01, $08
		db	$01, $03, $02, $08
		db	$01, $03, $02, $10
	end
