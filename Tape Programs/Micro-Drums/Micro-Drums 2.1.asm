;****************************************
;*                                      *
;*            MICRO_DRUMS               *
;*  MICROCOMPUTER CONTROLLED DRUM UNIT  *
;*                                      *
;*       (C) 1983  THOMAS HENRY         *
;*    VERSION 2.1  FEBRUARY 5, 1983     *
;*                                      *
;****************************************
;
;
IRQVEC	= $0000			;IRQ VECTOR.
PATTER	= $0003			;PATTERN POINTER BASE.
SELECT	= $0005			;DRUM SELECT BIT PATTERNS.
PARAMS	= $000D			;TAPE PARAMETERS.
BEAT	= $0014			;CURRENT BEAT POINTER.
SPOINT	= $0015			;CURRENT EVENT SELECTED.
REPEAT	= $0016			;CURRENT REPEAT COUNTER.
BUFFER	= $00F0			;KEYBOARD BUFFER.
SCORE	= $0280			;DRUM SCORE AREA.
DISPLA	= $0820			;DISPLAY ADDRESS.
DRUMS	= $0880			;DRUM OUTPUT ADDRESS.
RELAYS	= $0E25			;TURN ON TAPE RELAYS.
CASS	= $0EAA			;PERFORM CASSETTE OPERATION.
DECODE	= $0F00			;INPUT A BYTE.
GETKEY	= $0F1f			;GET A BYTE.
BEEP	= $0F22			;BEEP THE BEEPER.
LBEEP	= $0F24			;WITH SETUP, GIVES LONG BEEP.
SHIFT	= $0F34			;SHIFT BUFFER BY ONE DIGIT.
;
;
;*** MAIN LOOP ***
;
;
		org $0120
;
NUMBER	jsr	SHIFT		;SHIFT IN NEW DIGIT.
		lda BUFFER		;FETCH PACKED ENTRY.
		sta DISPLA		;THEN UPDATE THE DISPLAY.
		jmp INPUT		;GO GET NEXT INPUT.
MAIN	ldx #$FF		;GET READY FOR LONG BEEP.
		clc
		jsr LBEEP		;DO LONG BEEP.
INPUT	jsr GETKEY		;WAIT FOR KEYSTROKE.
		cmp #$10		;IS IT A NUMBER?
		bcc NUMBER		;YES, BRANCH BACK AND GET
FIND	cmp #$10		;IS IT 'PLAY'?
		beq PCMD
		cmp #$14		;IS IT 'COARSE'?
		beq COARSE
		cmp #$15		;IS IT 'FINE'?
		beq FINE
		cmp #$16		;IS IT 'TAPE'?
		bne MAIN		;RAN OUT OF COMMANDS.
		jmp TAPE
PCMD	jmp PLAY
;
;
;** FINE EDIT COMMAND **
;
;
FINE	lda BUFFER		;GET PATTERN NUMBER.
		jsr OFFSET		;GET PATTERN OFFSET.
		ldy #$00		;ZERO OUT THE BEAT POINTER.
SHOWIT	iny
BACKUP	dey
		sty DISPLA		;DISPLAY IT.
		lda (PATTER),y	;GET SELECTED BEAT,
		sta DRUMS		;AND PLAY IT.
FEDIT	jsr FETCH		;GET EDIT KEYSTROKE.
		cmp #$12		;IS IT A 'BACK'?
		beq BACKUP		;YES, BACKSPACE ONCE.
		cmp #$11		;IS IT A 'DISP'?
		beq SHOWIT		;YES, PLAY CURRENT BEAT.
		cmp #$0A		;IS IT A DRUM NUMBER (0-9)?
		bcc DENTER		;YES, GO ENTER DRUM BEAT.
		cmp #$13		;IS IT AN 'ENTER'?
		bne FEDIT		;NO, RAN OUT OF COMMANDS.
		iny				;YES, ADVANCE TO NEXT BEAT.
		jmp SHOWIT
DENTER	cmp #$09		;#$09 MEANS END OF PATTERN.
		bne NEXT1
		lda #$FF		;END OF PATTERN MARKER.
		sta (PATTER),y
		bne MAIN		;BRANCH ALWAYS
NEXT1	cmp #$08		;#$08 MEANS 'REST'
		bne NEXT2
		lda #$00
		beq STORE		;BRANCH ALWAYS
NEXT2	tax				;INDEX INTO BIT PATTERN.
		lda SELECT,x	;GET PROPER BIT PATTERN.
		eor (PATTER),y	;ADD IN NEW BEAT.
STORE	sta (PATTER),y	;AND SAVE IT.
		jmp SHOWIT		;SOUND THE DRUM BEAT.
;
;
;*** COARSE EDIT COMMAND ***
;
;
COARSE	ldx BUFFER		;GET DESIRED EVENT NUMBER.
		stx SPOINT		;STORE AT CURRENT EVENT.
REVEAL	ldx SPOINT
		lda SCORE,x		;GET CONTENTS OF EVENT.
		sta BUFFER		;PUT IN BUFFER AND
VIEW	sta DISPLA		;SHOW IT TOO.
LOOP	jsr GETKEY		;GET KEYSTROKE.
		cmp #$10		;CHECK FOR NUMBER.
		bcs NONUM		;NOT A NUMBER, BRANCH.
		jsr SHIFT		;SHIFT IN NEW DIGIT.
		lda BUFFER		;FETCH PACKED ENTRY.
		jmp VIEW		;AND UPDATE DISPLAY.
NONUM	cmp #$13		;IS IT AND 'ENTER'?
		bne NEXT3		;NO, GO ON.
		ldx SPOINT		;RE-GET EVENT NUMBER.
		lda BUFFER		;FETCH INPUT NUMBER.
		sta SCORE,x		;STORE IN SCORE.
		inc SPOINT		;UPDATE EVENT NUMBER.
		jmp REVEAL		;UPDATE DISPALY.
NEXT3	cmp #$12		;IS IT A BACKSPACE?
		bne NEXT4		;NO, BRANCH ON.
		dec SPOINT		;DECREMENT EVENT COUNTER.
		jmp REVEAL		;SHOW CONTENTS OF EVENT.
NEXT4	cmp #$14		;IS IT A 'PCH'?
		bne NEXT5		;NO, BRANCH ON.
		lda SPOINT		;GET CURRENT EVENT NUMBER.
		jmp VIEW		;AND SHOW IT.
NEXT5	cmp #$11		;IS IT A 'DISP'?
		beq REVEAL		;IF SO, SHOW CONTENTS.
		cmp #$17		;'REL' STANDS FOR ALL DONE.
		bne LOOP		;RAN OUT OF COMMANDS.
		ldx SPOINT		;RE-GET EVENT NUMBER.
		lda #$00		;END OF SCORE MARKER.
		sta SCORE,x
		jmp MAIN		;RETURN TO MAIN LOOP.
;
;
;*** 'PLAY' COMMAND ENTRY ***
;
;
PLAY	lda #$00		;ZERO OUT REPEAT AND
		sta REPEAT		;SCORE POINTER.
		lda #$FF
		sta SPOINT
		cli				;PREPARE FOR IRQ.
TIGHT	cmp #$FF		;#$FF MEANS KEEP PLAYING.
		beq TIGHT		;STAY IN TIGHT LOOP.
		jmp MAIN		;ABORT 'PLAY' NOW.
;
;
IRQRTN	jsr DECODE		;SEE IF ZERO KEY IS PUSHED
		cmp #$00
		bne PLAMOR		;IT ISN'T, SO PLAY MORE.
FINISH	plp				;SET INTERRUPT FLAG
		sei				;SO NO MORE OCCUR.
		php
RETURN	rti
;
;
PLAMOR	lda REPEAT		;REPEAT OLD PATTERN ENOUGH?
		bne MORE		;NO, KEEP GOING WITH OLD ONE.
		inc SPOINT		;YES, UPDATE SCORE POINTER.
		ldx SPOINT
		lda SCORE,x		;GET REPEAT TIME DATA.
		beq FINISH		;DONE PLAYING WHOLE SCORE.
		sta REPEAT		;CONTAINS NUMBER OF REPEATS.
		inc SPOINT		;UPDATE SCORE POINTER.
		ldx SPOINT
		lda SCORE,x		;GET PATTERN NAME DATA.
		jsr OFFSET		;GET PATTERN ADDRESS OFFSET.
		lda #$00
		sta BEAT		;ZERO OUT BEAT POINTER.
MORE	ldy BEAT		;Y INDEXES TO PROPER BEAT.
		lda (PATTER),y	;GET OUTPUT DATA.
		cmp #$FF		;END OF PATTERN?
		bne	OKAY		;NO, GO PLAY THE BEAT.
		dec	REPEAT		;DECREMENT REPEAT TIME.
		lda #$00		;YES, RESET BEAT COUNTER.
		sta BEAT		;THEN TRy AGAIN.
		beq IRQRTN		;BRANCH ALWAYS.
OKAY	sta DRUMS
		sty DISPLA
		inc BEAT		;UPDATE BEAT POINTER.
		lda #$FF
		bne RETURN		;BRANCH ALWAYS.
;
;
; *** 'LOAD' AND 'SAVE' COMMAND ***
;
;
TAPE	ldx #$07		;PREPARE TAPE PARAMETERS.
SETFIL	lda PARAMS-1,x	;GET PARAMETERS.
		sta BUFFER,x	;AND STUFF IN PLACE.
		dex
		bne SETFIL		;KEEP STUFFING IF NEEDED.
		lda BUFFER		;GET LOAD/SAVE TOKEN.
		jsr RELAYS		;TURN ON RELAYS.
		jsr CASS		;PERFORM LOAD OR SAVE.
		clc
		jsr BEEP		;TURN OFF RELAYS AND BEEP.
		jmp MAIN		;ALL DONE!
;
;
FETCH	sty BEAT		;GET A KEY, BUT SAVE
		jsr GETKEY		;CURRENT Y-REGISTER.
		ldy BEAT
		rts
;
;
OFFSET	asl a			;FIND OFFSET BY
		asl a			;MULTIPLYING ACCUMULATOR
		asl a			;BY SIXTEEN.
		asl a
		asl a
		sta PATTER		;OFFSET ADDRESS IS HERE
		rts
;
;
;** INITIALIZATION ROUTINE ***
;
;
		sei
		ldx #$00
MOVE	lda DATA,x		;GET DATA BYTE.
		sta IRQVEC,x	;STUFF IT INTO 0-PAGE
		inx
		cpx #$14		;NUMBER OF BYTES+1.
		bne MOVE
		ldy #$00		;CLEAR PATTERN AREA.
		lda #$00
CLEAR	sta (PATTER),y
		dey
		bne CLEAR
		jmp MAIN		;GO START UP MICRO-DRUMS.
;
;
;*** DATA AND ADDRESS TABLES ***
;
;
DATA	db $4C			;OPCODE FOR 'JMP'
		dw IRQRTN		;START OF IRQ ROUTINE.
		dw $0300		;PATTERN BASE ADDRESS.
		db $01, $02		;DRUM SELECT BIT PATTERNS.
		
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		dw $0280		;TAPE POINTER
		