;********************************
;*                              *
;*          SEQUE 1.0           *
;*                              *
;* MONOTONIC SEQUENCER PROGRAMS *
;*                              *
;*             BY               *
;*    JOHN S. SIMONTON, JR.     *
;*                              *
;*(C) 1978 PAIA ELECTRONICS, INC*
;*     ALL RGIHTS RESERVED      *
;*                              *
;********************************
;
;DEFINE ADDRESS OF LABELS
;
BEEP	=$1F22
DECD	=$1F00	
CASS	=$1EAA
DBIT	=$1E49
SBIT	=$1E25
OUTP	=$09FF	;$0840 in listing
DSP		=$0820
KBD		=$0810
;
MTBL3	=$0303
MTBL2	=$0302
MTBL1	=$0301
MTBL	=$0300
TTBL	=$02C0
;
BUFF	=$00F0
KBUF	=$00EC
PBUF	=$00EB
MPNT	=$00EA
TPNT	=$00E9
MEND	=$00E8
TEND	=$00E7
TRNS	=$00E6
CNTR	=$00E5
TTRN	=$00E4
LSTL	=$00E3
STUS	=$00E2
TPO		=$00E1
METF	=$00E0
MTRC	=$00DF
DUMY	=$0003
;
;
;
		org	$1000
;
STAR	lda	#$00	;START / RESTART
		sta	STUS	;CANCEL OPTIONS
		lda	#$0C	;NRML COMMAND LINK
		sta	ACTN+01	;PLACE COMMAND LINK
		jmp	COM		;JUMP TO COMMON
;
;NORMAL OPERATING MODE - DOES NOT ALTER
;T-SEQUENCE OR M-SEQUENCE
;
NRML	bcs	NRM1	;FIRST PASS THROUGH
		sta	TRNS	;ZERO TRANSPOSE
		sta	DSP		;AND DISPLAYS
NRM1	lda	KBUF	;CHECK FOR NOTES
		bne	STOR	;ZERO- NO NEW KEY
 		lda	PBUF	;SO GET OLD KEY
 		and	#$3F	;CLEAR BOTH FLAGS
STOR	sta	PBUF	;SAVE AGAIN
 		rts			;AND RETURN
;
;PROGRAM TRANSPOSE MODE - NOTE PLAYED
;IS "KILLED" WHEN KEY IS RELEASED
;
TLOD	bcs	TL1		;FIRST PASS, INITIALIZE
		sta	TRNS	;ZERO TRANSPOSE FIGURE
 		sta	PBUF	;ZERO OUTPUT NOTE
 		sta	TEND	;ZERO TABLE END POINTER
		lda	#$80	;TURN T-SEQUE OPTION
 		sta	STUS	;ON
TL1		ldx	TEND	;GET TRANSPOSE POINTER
		stx	DSP		;SHOW IT
		lda	KBUF	;GET THE NOTE
		beq	TL2		;ZERO- NO KEY, SAVE
		cmp	PBUF	;KEY SAME AS LAST?
		beq	TRTN	;YES - LEAVE
		inc	TEND	;POINT TO NEXT LOCATION
TL2		sta	TTBL,x	;SAVE TRANSPOSE
TRTN	sta	PBUF	;AND OUTPUT AS NOTE
		rts			;THEN RETURN
;
;PROGRAM SCORE MODE - USES REAL-TIME CLOCK
;
MSAV	jsr	MSV1	;CALL SAVE MODULE
 		inc	CNTR	;INCREMENT THE TEMPO
 		rts			;COUNTER AND RETURN
;
;CONTINUE PLAY MODE - DOES NOT RESET
;M-SEQUENCE OR T-SEQUENCE POINTERS
;
CNTU	sec			;SKIP INITIALIZATION
;
;REPEAT PLAY MODE - WHEN FIRST ENTERED
;M-SEQ AND T-SEQ POINTERS ARE SET TO ZERO
;BY THE PLAY MODULE (PLA1)
;
RPLA	jsr	PLA1	;CALL PLAY MODULE
		lda	STBL+$14;WAS THE PREVIOUS MODE
 		cmp	LSTL	;MSAV (PROG. SCORE)?
 		bne	RPL1	;NO-SKIP INCREMENT
 		inc	TPNT	;INC. T-SEQ POINTER
RPL1	bit	STUS	;T-SEQ ASSERTED ?
 		bmi	ROUT	;OPTION ON - LEAVE
 		lda	KBUF	;OPTION OFF- GET NOTE
 		beq	OLDK	;AND IF NO NOTE, BRANCH
 		sta	TTRN	;SAVE NOTE FOR NEXT TIME
OLDK	lda	TTRN	;GET LAST ACTIVE NOTE
 		sta	TRNS	;USE AS TRANSPOSE
ROUT	inc	CNTR	;INCREMENT TEMPO COUNTER
 		rts			;AND RETURN
;
;SINGLE PLAY MODE - WAITS FOR AGO KEY
;THEN PLAYS SEQUENCE ONCE THROUGH
;TRANSPOSED TO INDICAtED KEY
;
SING	bcc	SNG1	;FIRST PASS, BRANCH
 		lda	KBUF	;AGO KEY DOWN?
 		bne	RPLA	;YES - PLAY SEQUENCE
SNG1	jsr	RPLA	;NO - "PLAY" THEN RETURN
 		lda	MPNT	;M-SEQ POINTER > 0 ?
 		bne	SRTN	;YES - RETURN
		lda	#$00	;NO - PREPARE
 		sta	CNTR	;ZERO TEMPO COUNTER
 		ldx	MEND	;POINT TO LAST NOTE
		lda	MTBL1,x	;OF M-SEQ AND GET IT
 		sta	PBUF	;PLACE IN PLAY BUFFER
SRTN	rts			;THEN RETURN
;
;UP TEMPO AND DOWN TEMPO - COMMON PORTION
;OF BOTH PROGRAMS ON PAGE 2
;
UTMP	lda	#$7E	;THE OP-CODE FOR ROR
		bne	U_D		;BRANCH ALWAYS
DTMP	lda	#$3E	;THE OP-CODE FOR ROL
U_D		jmp	TCOM	;JUMP FOR THE REST
;
;REST MODE - EXTENDS NOTES OR UN-NOTES
;WHEN IN PROGRAM EVENT MODE
;
REST	clc			;PREPARE FOR ADDITTION
 		lda	CNTR	;GET TEMPO COUNTER
 		adc	TPO		;ADD TEMPO VALUE
 		sta	CNTR	;PUT COUNTER BACK
 		lda	LSTL	;AND RETURN TO
		sta	ACTN+01	;PREVIOUS OPERATING
 		rts			;MODE
;
;STOP/STEP MODE - STOPS PLAY WITHOUT
;CHANGING POINTERS. SINGLE STEPS THROUGH
;SEQUENCE
;
STEP	bcs	STP1	;NOT FIRST PASS=BRANCH
		lda	#$FF	;SET TEMPO COUNTER AT
		sta	CNTR	;"TIMED OUT" VALUE
		jsr	CONT	;CALL PART OF PLAY MODULE
		stx	DSP		;DISPLAY M-SEQ POINTER
		lda	#$00	;MAKE TRANSPOSE VALUE
		sta	TRNS	;EQUAL TO ZERO
STP1	rts			;AND RETURN
;
;PROGRAM EVENT MODE - SAVES M-SEQUENCE
;BUT SUBSTITUTES EVENT CLOCK FOR REAL-TIME
;CLOCK
;
ESAV	bcs	ES1		;FIRST PASS, INITIALIZE
		sta	CNTR	;TEMPO COUNTER AS ZERO
ES1		jsr	MSV1	;CALL SAVE MODULE
		lda	CNTR	;GET TEMPO COUNTER
		bne	EOUT	;NO ENTRY-RETURN
		clc			;PREPARE
		adc	TPO		;ADD TEMPO VALUE
		sta	CNTR	;SAVE AS TEMPO COUNTER
EOUT	rts			;TEHN RETURN
;
;OPTION MENU - RETURN TO PREVIOUS
;OPERATING MODE AFTER TURING ON OR
;CANCELLING OPTIONS
;
TBLM	sta	TPNT	;T-SEQ POINTER TO BEG
		lda	STUS	;ASSERT T-SEQ OPTION
		ora	#$80
		bne	MCOM	;BRANCH ASLWAYS
MET		lda	STUS	;TURN METRONOME ON
		ora	#$40
		bne	MCOM	;BRANCH ALWAYS
SYNC	lda	STUS	;TURN ON SYNC TO
		ora	#$01	;CLICK TRACK OPTION
		bne	MCOM	;BRANCH ALWAYS
CNCL	lda	#$00	;PREPARE AND
MCOM	sta	STUS	;CANCEL ALL OPTIONS
		jmp	TCM1	;JUMP FOR THE REST
;
;CLICK MODE - SEND CLICK TRACK TO TAPE
;AGO KEYBOARD SCAN RATE IS TIME
;
CLIK	clc			;PREPARE TO SEND "0"
		jsr	SBIT	;SEND IT
 		rts			;RETURN FOR KEYBOARD DELAY
;
;METRONOME TEMPO CHANGE - PROGRAM ON PAGE 2
;
TCHG	jmp	TCH		;JUMP TO PROGRAM
;
;DUMP M&T-SEQ TO TAPE - PROGRAM ON PAGE 2
;
OTAP	jmp	TOUT	;JUMP TO PROGRAM
;
;LOAD M&T-SEQ FROM TAPE - PROGRAM ON PAGE 2
;
ITAP	jmp	TIN		;JUMP TO PROGRAM
;
;
;COMMAND LINKS - LOW BYTE OF ADDRESS OF SUBS

;RAM contents start----------------------------------------
;ORG DD
		db	$FF, $FF
MTRC	db	$00
METF	db	$00
TPO		db	$80
STUS	db	$80
LSTL	db	$46, $00
CNTR	db	$01, $63
TEND	db	$08
MEND	db	$4A
TPNT	db	$04
MPNT	db	$0A
PBUF	db	$68
KBUF	db	$00
;
;PIEBUG
;
MSTACK	db	$FF
;
;POTSHOT
;
CHKSUM	db	$49
STATUS	db	$FF
COMAND
BUFF	db	$DD

IDENT	db	$01
ENDADR	db	$80, $02
BEGADR	db	$00, $00
PNTER	db	$F6, $00
;
;PIEBUG
;
LASTKE	db	$16
ACC		db	$77		;Accumulator
YREG	db	$0F		;Y-Register
XREG	db	$FE		;X-Register
PC		db	$0F, $F6	;Program counter low
STACKP	db	$FF		;Stack pointer (user)
PREG	db	$00		;Stack register
;RAM contents end------------------------------------------
;
;
;COMMAND LINKS - LOW BYTE OF ADDRESS OF SUBS
;
STBL	db	lo REST, lo REST, lo REST, lo REST
		db	lo SYNC, lo MET,  lo TBLM, lo CNCL
		db	lo CLIK, lo TCHG, lo DTMP, lo UTMP
		db	lo ITAP, lo OTAP, lo NRML, lo NRML
		db	lo CNTU, lo STEP, lo SING, lo RPLA
		db	lo MSAV, lo ESAV, lo TLOD, lo RPLA
;
;COMMON PROGRAM - DOES METRONOME WHEN ON
;ADDS PLAY AND TRASNPOSE BUFFERS TO GET
;OUTPUT NOTE, PLAYS NOTE, READS COMMAND
;KEYBOARD AND JUMPS TO SELECTED MODE
;SUBSTITUES CLICK SYNCH FOR KEYBOARD
;TIMING LOOP WHEN SYNC OPTION IS ASSERTED
;
COM		lda <lo STUS	;CHECK OPTIONS
 		pha				;SAVE A COPY
 		asl	a			;METRONOME ON ?
 		bpl	COM0		;NO - BRANCH
 		dec	<lo MTRC	;DECREMENT METRONOME COUNTER
		bpl	COM0		;NOT <0 YET, BRANCH
		ldx	<lo TPO		;TIME UP, GET TEMPO VALUE
		dex				;DECREMENT ONCE
		stx	<lo MTRC	;THEN SAVE AS COUNTER
		lda	#$80		;TO DETERMINE ALTERNATE DISPLAY
		tax				;CYCLE AND "PENDULUM" LEFT
		clc				;PREPARE FOR ADDITTION
		adc	<lo METF	;ADD FLIP-FLOP VALUE
		sta	<lo METF	;SAVE NEW VALUE
		bpl	MET1		;ALTERNATE? - DISPLAY
		lda	<lo PBUF	;OTHERWISE, GET OUTPUT
		ora	#$80		;SET D7
		sta	<lo PBUF	;SAVE IN PLAY BUFFER
		clc				;PREPARE AND
		jsr	SBIT		;CALL BEEP
		ldx	#$08		;"PENDULUM" RIGHT
MET1	stx	DSP			;SHOW PENDULUM
COM0	lda	TRNS		;IS THERE A TRANSPOSE ?
		beq	COM1		;NO - BRANCH
TRAN	clc				;YES - PREPARE
		adc	#$A4		;CALCULATE TRANSPOSE VALUE
COM1	clc				;MORE PREPARATION
		adc	<lo PBUF	;CALCULATE NOTE
COUT	sta	OUTP		;PLAY NOTE
		pla				;GET STUS (OPTION CODES)
		ror	a			;SYNC OPTION ON ?
		bcc	KRED		;NO - SKIP
		jsr	DBIT		;WAIT FOR CLIK
		jmp	CTRL		;SKIP READING AGO
;
KRED	bit	KBD			;WAIT FOR DUMMY SCAN
		bpl	KRED		;LOOP UNTIL STARTED
KR2		lda	KBD			;WAIT FOR SCAN TO START
		bmi	KR2			;LOOP UNTIL STARTED
KR3		bit	KBD			;CHECK FOR KEYS DOWN
		bmi	KRTN		;WHEN SCAN DONE, RETURN
		bvc	KR3			;CURRENT KEY NOT DOWN, LOOP
		lda	KBD			;KEY DOWN, GET IT
KRTN	sta	<lo KBUF	;SAVE RESULT
CTRL	jsr	DECD		;GET COMMAND
		bcs	DO			;OLD COMMAND - DO IT
		lda	STBL,y		;NEW COMMADN - GET LINK
		sta	ACTN+01		;PLACE LINK
DO		lda	#$00		;THIS WILL BE HANDY
ACTN	jsr	DUMY		;CALL OPERATION MODE
		lda	ACTN+01		;SAVE CURRENT COMMAND
		sta	<lo LSTL	;LINK FOR LATER
		bne	COM			;AND LOOP ALWAYS
;
;SAVE MODULE - TAKES CARE OF ALTERNATELY
;STACKING DURATIONS AND NOTES IN M-SEQUENCE
;USES WHAT WILL BE "END OF SEQUENCE"
;INDICATOR IN PLAY MODES AS POINTER
;
MSV1	bcs	MS1			;FIRST PASS?
		sta	MTBL1		;YES-ZERO PROGRAM NOTE
		sta	<lo MEND	;ZERO M-SEQ POINTER
		sta	TRNS		;ZERO TRANSPOSE
		sta	<lo PBUF	;ZERO OUTPUT NOTE
MS1		lda	<lo CNTR	;GET TIME SINCE LAST NOTE
		ldx	<lo MEND	;AND M-SEQ END POINTER
		sta	MTBL,x		;SAVE THE TIME
		jsr	NRM1		;IN CASE NO KEYS DOWN
		and	#$7F		;CLEAR D7 IN OUTPUT NOTE
		cmp	MTBL1,x		;SAME AS LAST NOTE?
		beq	OUT			;YES, LEAVE
		inx				;NO, SAVE BY INCREMENTING
		inx				;M-SEQ POINTER TWICE
		stx	<lo MEND	;AND SAVING AS END
		sta	MTBL1,x		;THEN SAVE NOTE
		lda	#$00		;AND ZERO TIME SINCE
		sta	<lo CNTR	;LAST NOTE
OUT		rts				;AND RETURN
;
;PLAY MODULE - MANAGES M-SEQ AND T-SEQ
;POINTERS AS WELL AS TEMPO CLOCK.
;DETERMINES WHEN NOTES ARE TO BE PLAYED
;
PLA1	bcs	CONT		;FIRST PASS ?
		sta	TTRN		;YES-ZERO TEMP. TRANSPOSE
LP1		sta	<lo TPNT	;ZERO T-SEQ POINTER
LP2		sta	<lo MPNT	;AND M-SEQ POINTER
		sta	<lo CNTR	;AND CLOCK (TEMPO CONTER)
CONT	lda	<lo CNTR	;GET CLOCK
		ldy	<lo TPNT	;GET T-SEQ POINTER
		ldx	<lo MPNT	;GET M-SEQ POINTER
		cmp	MTBL2,x		;TIME UP?
		bcc	PL1			;NO, BRANCH
		lda	#$00		;YES, PREP. COUNTER, ETC.
		sta	<lo CNTR	;FOR NEXT ACCUMULATION
		inx				;INCREMENT M-SEQ POINTER
		inx				;TWICE
		stx	<lo MPNT	;AND SAVE NEW POINTER
		cpx	<lo MEND	;END OF M-SEQ?
		bne	PL1			;NO - BRANCH
		iny				;YES, INC T-SEQ POINTER
		cpy	<lo TEND	;END OF T-SEQ ?
		bcs	LP1			;YES-START T&M-SEQ AGAIN
		sty	<lo TPNT	;NO-SAVE T-SEQ POINTER
		bne	LP2			;BRANCH-START M-SEQ AGAIN
PL1		lda	MTBL3,x		;GET THE NOTE
		sta	<lo PBUF	;SAVE IN PLAY BUFFER
		lda	TTBL,y		;GET TRANSPOSE
		sta	<lo TRNS	;TO TRANSPOSE BUFFER
		rts				;RETURN
;
;TAPE TRANSFER PARAMETER TABLE
;
TAPE	db	$FF, $00, $FF, $03, $C0, $02, $C0, $02
;
		db	$FF, $FF, $FF, $FF, $FF, $FF, $FF, $11
		db	$34, $1A, $11, $34, $1A, $41, $0E, $01
		db	$01, $79, $0E, $C3, $0E, $14, $0E
;
;COMMON PORTION OF TEMPO UP & DOWN -
;ROTATES RIGHT OR LEFT THE DURATIONS
;SAVED WITH M-SEQUENCE
;
TCOM	sta	PLAC		;PLACE ROR OR ROL OP CODE
		ldx	#$00		;ZERO A COUNTER/POINTER
TLP		clc				;PREPARE
PLAC	ror	MTBL2,x		;ROTATE SAVED TEMPO
		inx				;INCREMENT POINTER TWICE
		inx				;TO POINT TO NEXT
		cpx	<lo MEND	;END OF M-SEQ ?
		bne	TLP			;NO - LOOP FOR MORE
TCM1	lda	<lo LSTL	;DONE, GET LINK AND
		sta	ACTN+01		;SET UP FOR PREVIOUS MODE
		rts				;THEN RETURN
;
;SET UP PROCEDURE FOR TAPE TRANSFER
;
STTP	ldx	#$07		;TRANSFER 7 BYTES
STP		lda	TAPE,x		;GET PARAMETER FROM TABLE
		sta	<lo BUFF,x	;PLACE IN POT-SHOT BUFFER
		dex				;POINT TO NEXT, MORE ?
		bne	STP			;YES - LOOP
		rts				;NO - RETURN
;
;DUMP M-SEQ AND T-SEQ TO TAPE
;
TOUT	jsr	STTP		;SET UP FOR TRANSFER
		lda	<lo MEND	;SAVE M-SEQ END WITH
		sta	MTBL		;M&T-SEQUENCE
		lda	<lo TEND	;ALSO T-SEQUENCE END
		sta	MTBL1
		lda	#$DD		;SET UP FOR DUMP
		jsr	DOTP		;AND DO IT
		rts				;THEN RETURN
;
;LOAD M-SEQ AND T-SEQ FROM TAPE
;
TIN		jsr	STTP		;SET UP FOR TRANSFER
		lda	#$11		;SET UP FOR LOAD
		jsr	DOTP		;AND DO IT
		lda	MTBL		;PLACE M-SEQUENCE END
		sta	<lo MEND
		lda MTBL1		;AND T-SEQUENCE END
		sta	<lo TEND
		rts				;THEN RETURN
;
;PERFORM TAPE TRANSFER
;
DOTP	jsr	CASS		;CALL POT-SHOT
		lda	STBL+$F		;SET UP TO RETURN
		sta	ACTN+01		;IN NORMAL MODE
		clc				;PREPARE
		jsr	BEEP		;SIGNAL DONE
		rts				;AND RETURN
;
;CHANGE METRONOME TEMPO
;
TCH		sta	<lo MTRC	;ZERO METRONOME CLOCK
		ror	<lo TPO		;HALVE TEMPO VALUE
		bcc	TCHR		;IF NOT ZERO, LEAVE
		ror	<lo TPO		;ZERO, MAKE NOT ZERO
TCHR	bne TCM1		;GO SET UP PREVIOUS MODE

		db	$FF, $FF, $F0, $DF, $F2, $7F, $70, $9F
		db	$B2, $EF, $F1, $DB, $D2, $FB, $72, $BF
		db	$E2, $DF, $10, $3F, $F0, $AF, $40, $DF
		db	$C0, $FF, $00, $EF, $70, $FF, $F0, $DF
		db	$60, $FF, $30
		